## main/Kconfig.projbuild
```kconfig
menu "Daddy Status"

    config NTP_SERVER
        string "NTP server for TLS clock synchronization"
        default "pool.ntp.org"

    config STATUS_DIAGNOSTICS
        bool "Log heap and task stack diagnostics"
        default n

    config PRESENCE_POLL_SECONDS
        int "Presence polling interval (seconds)"
        range 2 300
        default 15

    config PRESENCE_STALE_SECONDS
        int "Mark presence stale after (seconds; must exceed polling interval)"
        range 30 3600
        default 60

    menu "LEDs"
        config LED_BRIGHTNESS_PERCENT
            int "LED brightness (percent)"
            range 1 100
            default 100

        config LED_DATA_GPIO
            int "Data GPIO pin number"
            range 0 33
            default 25
            help
                GPIO number of data to LED array
    endmenu

    menu "Microsoft Entra ID"
        config AAD_TENANT_ID
            string "Tenant ID that the Graph API belongs to"
            default ""
        
        config AAD_CLIENT_ID
            string "Client ID of the app with the permissions to fetch presence"
            default ""
    endmenu

endmenu

menu "WiFi setup"

    config SETUP_PASSWORD
        string "Recovery Wi-Fi password (12-63 characters; empty disables recovery AP)"
        default ""
        help
            A private password for Daddy-Status-Setup. The network is enabled
            after three minutes without station Wi-Fi and disabled on reconnection.
            Configure before flashing; do not commit real passwords.


    config WIFI_SSID
        string "WiFi SSID"
        default ""
        help
            SSID of the 2.4 GHz network to connect to.

    config WIFI_PASSWORD
        string "WiFi Password"
        default ""
        help
            Wi-Fi password. Leave empty only for an open network.

    config WIFI_LISTEN_INTERVAL
        int "WiFi listen interval"
        range 1 100
        default 3
        help
            Interval for station to listen to beacon from AP. The unit of listen interval is one beacon interval.
            For example, if beacon interval is 100 ms and listen interval is 3, the interval for station to listen
            to beacon is 300 ms.
endmenu

menu "Power saving setup"
    choice POWER_SAVE_MODE
        prompt "power save mode"
        default POWER_SAVE_MIN_MODEM
        help
            Power save mode for the esp32 to use. Modem sleep mode includes minimum and maximum power save modes.
            In minimum power save mode, station wakes up every DTIM to receive beacon. Broadcast data will not be
            lost because it is transmitted after DTIM. However, it can not save much more power if DTIM is short
            for DTIM is determined by AP.
            In maximum power save mode, station wakes up every listen interval to receive beacon. Broadcast data
            may be lost because station may be in sleep state at DTIM time. If listen interval is longer, more power
            is saved but broadcast data is more easy to lose.

        config POWER_SAVE_NONE
            bool "none"
        config POWER_SAVE_MIN_MODEM
            bool "minimum modem"
        config POWER_SAVE_MAX_MODEM
            bool "maximum modem"
    endchoice

endmenu
```

## sdkconfig.defaults
```kconfig
CONFIG_IDF_TARGET="esp32"
CONFIG_ESPTOOLPY_FLASHSIZE_4MB=y
CONFIG_PARTITION_TABLE_CUSTOM=y
CONFIG_PARTITION_TABLE_CUSTOM_FILENAME="partitions.csv"
CONFIG_BOOTLOADER_APP_ROLLBACK_ENABLE=y
CONFIG_MBEDTLS_CERTIFICATE_BUNDLE=y
CONFIG_FREERTOS_HZ=1000
CONFIG_ESP_MAIN_TASK_STACK_SIZE=6144
```
